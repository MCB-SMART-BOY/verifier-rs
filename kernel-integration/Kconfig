## kernel-integration/Kconfig
```kconfig
# SPDX-License-Identifier: GPL-2.0-only

config BPF_VERIFIER_RUST
	bool "Rust implementation of BPF verifier"
	depends on BPF_SYSCALL
	depends on RUST
	depends on !RUST_IS_AVAILABLE_BINDGEN_LIBCLANG || RUST_BINDGEN_VERSION_TEXT >= "0.69"
	default n
	help
	  This option enables the Rust implementation of the BPF verifier
	  as an alternative to the C implementation.

	  The Rust verifier provides the same functionality as the C verifier
	  but with additional compile-time safety guarantees provided by Rust's
	  type system and ownership model.

	  When enabled, you can switch between verifiers at runtime via sysctl:
	    echo 1 > /proc/sys/kernel/bpf_rust_verifier

	  This requires Rust 1.83.0 or later and bindgen 0.69.0 or later.

	  If unsure, say N.

config BPF_VERIFIER_RUST_DEFAULT
	bool "Use Rust BPF verifier by default"
	depends on BPF_VERIFIER_RUST
	default n
	help
	  When enabled, the Rust BPF verifier will be used by default instead
	  of the C verifier. The C verifier remains available as a fallback
	  and can be selected via sysctl.

	  If unsure, say N.

config BPF_VERIFIER_RUST_DEBUG
	bool "Enable Rust BPF verifier debug output"
	depends on BPF_VERIFIER_RUST
	depends on DEBUG_KERNEL
	default n
	help
	  Enable verbose debug output from the Rust BPF verifier.
	  This can be useful for debugging verifier issues but may
	  significantly impact performance and log size.

	  Only enable this for development and debugging.

	  If unsure, say N.
```
